## Kconfig
```kconfig
# Sensor data simulator
#
# Copyright (c) 2019 Nordic Semiconductor
#
# SPDX-License-Identifier: LicenseRef-Nordic-5-Clause
#

DT_COMPAT_ZMK_OUTPUT_BEHAVIOR_LISTENER := zmk,output-behavior-listener
config ZMK_OUTPUT_BEHAVIOR_LISTENER
		bool
		default $(dt_compat_enabled,$(DT_COMPAT_ZMK_OUTPUT_BEHAVIOR_LISTENER))

DT_COMPAT_ZMK_OUTPUT_BEHAVIOR_GENERIC := zmk,output-behavior-geenric
config ZMK_OUTPUT_BEHAVIOR_GENERIC
		bool
		default $(dt_compat_enabled,$(DT_COMPAT_ZMK_OUTPUT_BEHAVIOR_GENERIC))

DT_COMPAT_ZMK_OUTPUT_GENERIC := zmk,output-generic
config ZMK_OUTPUT_GENERIC
		bool
		default $(dt_compat_enabled,$(DT_COMPAT_ZMK_OUTPUT_GENERIC))

DT_COMPAT_ZMK_OUTPUT_HAPTIC_FEEDBACK := zmk,output-haptic-feedback
config ZMK_OUTPUT_HAPTIC_FEEDBACK
		bool
		default $(dt_compat_enabled,$(DT_COMPAT_ZMK_OUTPUT_HAPTIC_FEEDBACK))

DT_COMPAT_ZMK_OUTPUT_PWM := zmk,output-pwm
config ZMK_OUTPUT_PWM
		bool
		select PWM
		default $(dt_compat_enabled,$(DT_COMPAT_ZMK_OUTPUT_PWM))

DT_COMPAT_ZMK_OUTPUT_SPLIT_OUTOUT_RELAY := zmk,output-split-output-relay
config ZMK_OUTPUT_SPLIT_OUTOUT_RELAY
		bool
		default $(dt_compat_enabled,$(DT_COMPAT_ZMK_OUTPUT_SPLIT_OUTOUT_RELAY))

config ZMK_OUTPUT_DEFAULT_FORCE
    int "Force of output on key pressed"
    default 128

config ZMK_OUTPUT_DEFAULT_DURATION
    int "Duration of output on key pressed"
    default 20
```

## dts/bindings/zmk,output-behavior-generic.yaml
```yaml
# Copyright (c) 2020 The ZMK Contributors
# SPDX-License-Identifier: MIT

description: |
  Listener to subscribe to input events and send HID updates after processing

compatible: "zmk,output-behavior-generic"

include: zero_param.yaml

properties:
  device:
    type: phandle
    required: true
  delay:
    type: int
    default: 0
  time-to-live-ms:
    type: int
    default: 0
  toggle:
    type: boolean
  force:
    type: int
    default: 0
  momentum:
    type: boolean
  momentum-force:
    type: int
    default: 0
  positional:
    type: boolean
```

## dts/bindings/zmk,output-behavior-listener.yaml
```yaml
# Copyright (c) 2020 The ZMK Contributors
# SPDX-License-Identifier: MIT

description: |
  Listener to subscribe to input events and send HID updates after processing

compatible: "zmk,output-behavior-listener"

properties:
  sources:
    type: array
    default: [-1]
  layers:
    type: array
    default: [-1]
  position:
    type: int
  invert-state:
    type: boolean
  all-state:
    type: boolean
  tap-ms:
    type: int
    default: -1
  bindings:
    type: phandle-array
```

## dts/bindings/zmk,output-generic.yaml
```yaml
# Copyright (c) 2024 The ZMK Contributors
# SPDX-License-Identifier: MIT

description: |
  Generic driver for controlling output gpios

compatible: "zmk,output-generic"

properties:
  control-gpios:
    type: phandle-array
    required: true
```

## dts/bindings/zmk,output-haptic-feedback.yaml
```yaml
# Copyright (c) 2024 The ZMK Contributors
# SPDX-License-Identifier: MIT

description: |
  Generic driver for controlling output haptic feedback motor driver

compatible: "zmk,output-haptic-feedback"

properties:
  driver:
    type: string
    enum:
      - drv2605
    description: ERM / LRA haptic feebback driver to use
  device:
    type: phandle
```

## dts/bindings/zmk,output-motorized-fader.yaml
```yaml
# Copyright (c) 2024 The ZMK Contributors
# SPDX-License-Identifier: MIT

description: |
  Generic driver for controlling motorized fader

compatible: "zmk,output-motorized-fader"

properties:

  sensor-device:
    type: phandle
    description: sensor device, which called via sensor_channel_get()

  sensor-channel:
    type: int
    default: 0
    description: sensor channel index of returned values from sensor_channel_get()

  motor-driver-device:
    type: phandle
    description: h-bridge motor device, which called via sensor_attr_set()
  motor-driver:
    type: string
    enum:
      - tb6612fng
    description: h-bridge driver to use
  motor-channel:
    type: int
    default: 0

  proportional:
    type: int
    default: 1
  integral:
    type: int
    default: 1
  derivative:
    type: int
    default: 1
```

## dts/bindings/zmk,output-pwm.yaml
```yaml
# Copyright (c) 2024 The ZMK Contributors
# SPDX-License-Identifier: MIT

description: |
  PWM driver for controlling output gpios

compatible: "zmk,output-pwm"

properties:
  pwms:
    required: true
    type: phandle-array
    description: PWM specifier driving the output.
```

## dts/bindings/zmk,output-split-output-relay.yaml
```yaml
# Copyright (c) 2024 The ZMK Contributors
# SPDX-License-Identifier: MIT

description: |
  Generic driver for controlling output to split output relay

compatible: "zmk,output-split-output-relay"
```
